## meta-yantul/conf/distro/include/yantul-base.inc
```bitbake
DISTROOVERRIDES .= ":ytlinux"

TCLIBCAPPEND = ""

QEMU_TARGETS ?= "arm aarch64 i386 riscv32 riscv64 ppc64le x86_64"

PREMIRRORS ??= "\
    	"

SANITY_TESTED_DISTROS ?= " \
            poky-2.4 \n \
            poky-2.5 \n \
            ubuntu-15.04 \n \
            ubuntu-16.04 \n \
            ubuntu-16.10 \n \
            ubuntu-17.04 \n \
            fedora-26 \n \
            centos-7 \n \
            debian-8 \n \
            debian-9 \n \
            opensuse-42.1 \n \
            opensuse-42.2 \n \
            "

DISTRO_NAME = "ytlinux (Written by avery.)"

DISTRO_FEATURES ?= " wayland"

DISTRO_FEATURES_DEFAULT = " \
		"

LAYER_CONF_VERSION ?= "8"
```

## meta-yantul/conf/machine/x86-64.conf
```bitbake
KMACHINE = "others"

DEFAULTTUNE ?= "arm1176jzfshf"
require conf/machine/include/tune-arm1176jzf-s.inc

TARGET_ARCH = "arm"
SERIAL_CONSOLE = "115200 ttyS0"
KERNEL_IMAGETYPE = "zImage"
IMAGE_FSTYPES = "tar.gz jffs2"
```
